## CMakeLists.txt
```
#
# Copyright (c) 2020 Nordic Semiconductor
#
# SPDX-License-Identifier: LicenseRef-BSD-5-Clause-Nordic
#

cmake_minimum_required(VERSION 3.8.2)

find_package(Zephyr REQUIRED HINTS $ENV{ZEPHYR_BASE})
project(NAT_testFirmware)

target_sources(app PRIVATE src/main.c)
target_sources(app PRIVATE src/nat_cmd.c)
target_sources(app PRIVATE src/nat_test.c)
```

## Kconfig
```
#
# Copyright (c) 2018 Nordic Semiconductor ASA
#
# SPDX-License-Identifier: LicenseRef-BSD-5-Clause-Nordic
#

menu "NAT Test Firmware"

menu "Firmware versioning"

config NAT_TEST_VERSION
	string "The version of the NAT Test Firmware"
	default "0.0.0-development"

endmenu # Firmware versioning

endmenu # NAT Test Firmware

menu "Zephyr Kernel"
source "Kconfig.zephyr"
endmenu

module = NAT_TEST
module-str = NAT Test Firmware
```

## west.yml
```
manifest:
  remotes:
    - name: nordic
      url-base: https://github.com/nrfconnect
  projects:
    - name: sdk-nrf
      path: nrf
      remote: nordic
      revision: 4c0d3be2ed4ade4dc3e614e95e6f8e4330d663b4
      import: true
  self:
    path: firmware
```

## prj.conf
```kconfig
# General
CONFIG_NO_OPTIMIZATIONS=y
CONFIG_SERIAL=y
CONFIG_STDOUT_CONSOLE=y
CONFIG_UART_INTERRUPT_DRIVEN=y
CONFIG_REBOOT=y
CONFIG_ASSERT=y

# Networking
CONFIG_BSD_LIBRARY=y
CONFIG_NETWORKING=y
CONFIG_NET_SOCKETS_OFFLOAD=y
CONFIG_NET_SOCKETS=y
CONFIG_NET_NATIVE=n

# Logging
CONFIG_LOG=y
CONFIG_LOG_IMMEDIATE=y
CONFIG_LOG_DEFAULT_LEVEL=4

# LTE link control
CONFIG_LTE_LINK_CONTROL=y
CONFIG_LTE_AUTO_INIT_AND_CONNECT=n
CONFIG_LTE_LINK_CONTROL_LOG_LEVEL_DBG=y
CONFIG_LTE_NETWORK_USE_FALLBACK=n
CONFIG_LTE_NETWORK_MODE_LTE_M=y
CONFIG_LTE_NETWORK_TIMEOUT=300

# Heaps and stacks
CONFIG_MAIN_STACK_SIZE=8192
CONFIG_HW_STACK_PROTECTION=y
CONFIG_HEAP_MEM_POOL_SIZE=16384
CONFIG_SYSTEM_WORKQUEUE_STACK_SIZE=4096

# Modem info
CONFIG_MODEM_INFO=y
CONFIG_MODEM_INFO_ADD_DATE_TIME=n
CONFIG_CJSON_LIB=y
CONFIG_NEWLIB_LIBC=y
CONFIG_NEWLIB_LIBC_FLOAT_PRINTF=y

# AT commands
CONFIG_AT_CMD=y

# Shell
CONFIG_SHELL=y
CONFIG_SHELL_STACK_SIZE=8192
CONFIG_DEVICE_SHELL=y
CONFIG_KERNEL_SHELL=y

# Led
CONFIG_DK_LIBRARY=y
CONFIG_DK_LIBRARY_INVERT_LEDS=n
```

## src/main.c
```c
/*
 * Copyright (c) 2020 Nordic Semiconductor ASA
 *
 * SPDX-License-Identifier: LicenseRef-BSD-5-Clause-Nordic
 */

#include <zephyr.h>
#include <zephyr/types.h>
#include <cJSON_os.h>
#include <modem/lte_lc.h>
#include <modem/modem_info.h>
#include <power/reboot.h>
#include <dk_buttons_and_leds.h>

#include "nat_test.h"

K_SEM_DEFINE(lte_connected_startup, 0, 1);
volatile enum lte_lc_nw_reg_status network_status;
volatile enum lte_lc_system_mode network_mode;

struct k_sem getaddrinfo_sem;

int get_network_mode(void)
{
	return network_mode;
}

int set_network_mode(int mode)
{
	if (mode != LTE_LC_SYSTEM_MODE_LTEM &&
	    mode != LTE_LC_SYSTEM_MODE_NBIOT) {
		return -INVALID_MODE;
	} else if (get_test_state() != IDLE) {
		return -TEST_RUNNING;
	} else if (network_mode == mode) {
		return 0;
	}

	network_mode = mode;

	lte_lc_offline();
	lte_lc_system_mode_set(mode);
	lte_lc_normal();

	return 0;
}

int get_network_status(void)
{
	return network_status;
}

static void lte_handler(const struct lte_lc_evt *const evt)
{
	s64_t start_time_ms = 0;
	s64_t total_time_ms = 0;

	switch (evt->type) {
	case LTE_LC_EVT_NW_REG_STATUS:
		switch (evt->nw_reg_status) {
		case LTE_LC_NW_REG_REGISTERED_HOME:
		case LTE_LC_NW_REG_REGISTERED_ROAMING:
			start_time_ms = 0;

			/* Only used during startup */
			k_sem_give(&lte_connected_startup);
			break;
		case LTE_LC_NW_REG_SEARCHING:
		case LTE_LC_NW_REG_UNKNOWN:
			if (network_status == LTE_LC_NW_REG_REGISTERED_HOME ||
			    network_status ==
				    LTE_LC_NW_REG_REGISTERED_ROAMING) {
				start_time_ms = k_uptime_get();
			} else if (start_time_ms > 0) {
				total_time_ms += k_uptime_delta(&start_time_ms);
			}

			if (total_time_ms >= CONFIG_LTE_NETWORK_TIMEOUT) {
				printk("LTE link could not be established.\n");
				printk("Rebooting...\n");
				sys_reboot(SYS_REBOOT_WARM);
			}
			break;
		case LTE_LC_NW_REG_REGISTRATION_DENIED:
		case LTE_LC_NW_REG_UICC_FAIL:
			printk("LTE link could not be established.\n");
			printk("Rebooting...\n");
			sys_reboot(SYS_REBOOT_WARM);
			break;
		default:
			break;
		}

		network_status = evt->nw_reg_status;

		break;
	default:
		break;
	}
}

static void indicate_status_with_led(void)
{
	int current_led = DK_LED1;
	int next_led = DK_LED1;
	bool on = false;

	while (true) {
		switch (get_test_state()) {
		case UNINITIALIZED:
		case IDLE:
			current_led = next_led;

			dk_set_led_off(DK_LED1);

			switch (next_led) {
			case DK_LED1:
				next_led = DK_LED2;
				break;
			case DK_LED2:
				next_led = DK_LED4;
				break;
			case DK_LED4:
				next_led = DK_LED3;
				break;
			case DK_LED3:
			default:
				next_led = DK_LED1;
				break;
			}

			dk_set_led_off(current_led);
			dk_set_led_on(next_led);
			break;
		case RUNNING:
		case ABORT:
		default:
			dk_set_led_off(next_led);

			on = !on;

			if (on) {
				dk_set_led_on(DK_LED1);
			} else {
				dk_set_led_off(DK_LED1);
			}
			break;
		}

		k_sleep(K_SECONDS(1));
	}
}

void main(void)
{
	int err;

	printk("NAT-test client started\n");
	printk("Version: %s\n", CONFIG_NAT_TEST_VERSION);

	if (IS_ENABLED(CONFIG_LTE_NETWORK_MODE_NBIOT)) {
		network_mode = LTE_LC_SYSTEM_MODE_NBIOT;
	} else {
		network_mode = LTE_LC_SYSTEM_MODE_LTEM;
	}
	network_status = LTE_LC_NW_REG_NOT_REGISTERED;

	printk("Setting up LTE connection\n");

	err = lte_lc_init_and_connect_async(lte_handler);
	if (err) {
		printk("Error initializing and connecting to LTE, error: %d\n",
		       err);
		return;
	}

	k_sem_take(&lte_connected_startup, K_FOREVER);

	printk("LTE connected\n");

	k_sem_init(&getaddrinfo_sem, 0, 1);

	dk_leds_init();

	cJSON_Init();

	err = modem_info_init();
	if (err) {
		printk("Modem info could not be initialised: %d\n", err);
		return;
	}

	nat_test_init();
	nat_cmd_init();
	k_sem_give(&getaddrinfo_sem);

	err = nat_test_start(TEST_UDP_AND_TCP);
	if (err) {
		printk("Test was already running.\n");
	}

	indicate_status_with_led();
}
```

## src/nat_cmd.c
```c
/*
 * Copyright (c) 2020 Nordic Semiconductor ASA
 *
 * SPDX-License-Identifier: LicenseRef-BSD-5-Clause-Nordic
 */

#include <cJSON.h>
#include <cJSON_os.h>
#include <modem/at_cmd.h>
#include <modem/lte_lc.h>
#include <modem/modem_info.h>
#include <net/socket.h>
#include <shell/shell.h>
#include <shell/shell_uart.h>
#include <modem/lte_lc.h>
#include <stdio.h>
#include <stdlib.h>
#include <zephyr.h>

#include "nat_test.h"

#define AT_CMD_SERVER_PORT 3060
#define AT_LOG_TIMEOUT_S 20

struct at_cmd_log {
	void *fifo_reserved;
	char cmd[BUF_SIZE];
	char res[BUF_SIZE];
};

K_FIFO_DEFINE(at_cmd_fifo);

K_THREAD_STACK_DEFINE(nat_cmd_thread_stack_area, THREAD_STACK_SIZE);
struct k_thread thread;

static void handle_at_cmd(const struct shell *shell, size_t argc, char **argv)
{
	int err;
	char response[200];
	enum at_cmd_state state;

	if (argc <= 1) {
		shell_print(shell, "AT command was not provided\n");
		return;
	}

	err = at_cmd_write(argv[1], response, sizeof(response), &state);
	if (err < 0) {
		shell_print(shell, "Error while processing AT command: %d\n",
			    err);
		state = AT_CMD_ERROR;
	}

	switch (state) {
	case AT_CMD_OK:
		shell_print(shell, "%s\n", response);
		shell_print(shell, "OK\n");
		struct at_cmd_log *item;

		item = k_malloc(sizeof(*item));

		if (item == NULL) {
			shell_print(shell,
				    "Failed to allocate at_cmd_log item.\n");
			break;
		}
		strcpy(item->cmd, argv[1]);
		strcpy(item->res, response);

		k_fifo_put(&at_cmd_fifo, (void *)item);
		break;
	case AT_CMD_ERROR:
		shell_print(shell, "ERROR\n");
		break;
	default:
		break;
	}
}

SHELL_CMD_REGISTER(at, NULL, "AT commands", handle_at_cmd);

static void handle_set_timeout(const struct shell *shell, size_t argc,
			       char **argv)
{
	u32_t value;

	if (argc <= 1) {
		shell_print(shell, "Timeout value was not provided\n");
		return;
	}

	value = strtol(argv[1], NULL, 10);
	if (value <= 0) {
		shell_print(shell, "Timeout value needs to be > 0\n");
	}

	if (!strcmp(argv[-2], "udp")) {
		udp_initial_timeout = value;
		shell_print(shell, "UDP timeout multiplier set to: %d",
			    udp_initial_timeout);
	} else if (!strcmp(argv[-2], "tcp")) {
		tcp_initial_timeout = value;
		shell_print(shell, "TCP timeout multiplier set to: %d",
			    tcp_initial_timeout);
	}
}

static void handle_get_timeout(const struct shell *shell, size_t argc,
			       char **argv)
{
	if (!strcmp(argv[-2], "udp")) {
		shell_print(shell, "UDP initial timeout: %d\n",
			    udp_initial_timeout);
	} else if (!strcmp(argv[-2], "tcp")) {
		shell_print(shell, "TCP initial timeout: %d\n",
			    tcp_initial_timeout);
	}
}

static void handle_set_multiplier(const struct shell *shell, size_t argc,
				  char **argv)
{
	float value;
	char msg[40];

	if (argc <= 1) {
		shell_print(shell, "Multiplier value was not provided\n");
		return;
	}

	value = strtof(argv[1], NULL);
	if (value <= 1) {
		shell_print(shell, "Multiplier value needs to be > 1\n");
	}

	if (!strcmp(argv[-2], "udp")) {
		udp_timeout_multiplier = value;
		snprintf(msg, 40, "UDP timeout multiplier set to: %.1f\n",
			 udp_timeout_multiplier);
		shell_print(shell, "%s", msg);
	} else if (!strcmp(argv[-2], "tcp")) {
		tcp_timeout_multiplier = value;
		snprintf(msg, 40, "TCP timeout multiplier set to: %.1f\n",
			 tcp_timeout_multiplier);
		shell_print(shell, "%s", msg);
	}
}

static void handle_get_multiplier(const struct shell *shell, size_t argc,
				  char **argv)
{
	char msg[40];

	if (!strcmp(argv[-2], "udp")) {
		snprintf(msg, 40, "UDP timeout multiplier: %.1f\n",
			 udp_timeout_multiplier);
		shell_print(shell, "%s", msg);
	} else if (!strcmp(argv[-2], "tcp")) {
		snprintf(msg, 40, "TCP timeout multiplier: %.1f\n",
			 tcp_timeout_multiplier);
		shell_print(shell, "%s", msg);
	}
}

static void handle_start_test(const struct shell *shell, size_t argc,
			      char **argv)
{
	int err;
	enum test_type type;

	if (!strcmp(argv[0], "udp")) {
		type = TEST_UDP;
	} else if (!strcmp(argv[0], "tcp")) {
		type = TEST_TCP;
	} else if (!strcmp(argv[0], "udp_and_tcp")) {
		type = TEST_UDP_AND_TCP;
	} else {
		shell_print(shell, "Invalid test type\n");
		return;
	}

	err = lte_lc_psm_req(false);
	if (err < 0) {
		shell_print(
			shell,
			"Failed to disable Power Saving mode.\nRequest to start test denied.\n");
		return;
	}

	err = lte_lc_edrx_req(false);
	if (err < 0) {
		shell_print(
			shell,
			"Failed to disable use of eDRX.\nRequest to start test denied.\n");
		return;
	}

	err = nat_test_start(type);
	if (err < 0) {
		shell_print(shell, "Another test is still active\n");
		return;
	}
}

static void handle_stop_test(const struct shell *shell, size_t argc,
			     char **argv)
{
	int err;

	err = nat_test_stop();
	if (err < 0) {
		shell_print(
			shell,
			"Unable to stop running test\nTry again in a few minutes\n");
		return;
	}
	shell_print(shell, "Test stopped\n");
}

static void handle_get_network_mode(const struct shell *shell, size_t argc,
				    char **argv)
{
	enum lte_lc_system_mode network_mode = get_network_mode();

	if (network_mode == LTE_LC_SYSTEM_MODE_NBIOT) {
		shell_print(shell, "Network mode: NB-IoT\n");
	} else if (network_mode == LTE_LC_SYSTEM_MODE_LTEM) {
		shell_print(shell, "Network mode: LTE-M\n");
	}
}

static void handle_set_network_mode(const struct shell *shell, size_t argc,
				    char **argv)
{
	long mode = strtol(argv[1], NULL, 10);
	int err = set_network_mode(mode);

	if (err == -INVALID_MODE) {
		shell_print(shell, "Invalid mode\n");
		return;
	} else if (err == -TEST_RUNNING) {
		shell_print(shell, "Active test - Unable to change mode\n");
		return;
	}

	if (mode == LTE_LC_SYSTEM_MODE_NBIOT) {
		shell_print(shell, "Changed network mode to NB-IoT\n");
	} else if (mode == LTE_LC_SYSTEM_MODE_LTEM) {
		shell_print(shell, "Changed network mode to LTE-M\n");
	}
}

static void handle_get_network_status(const struct shell *shell, size_t argc,
				      char **argv)
{
	shell_print(shell, "Network connection status: %d\n",
		    get_network_status());
}

SHELL_STATIC_SUBCMD_SET_CREATE(network_mode_accessor_cmds,
			       SHELL_CMD(set, NULL, "Set network mode",
					 handle_set_network_mode),
			       SHELL_CMD(get, NULL, "Get network mode",
					 handle_get_network_mode),
			       SHELL_SUBCMD_SET_END);
SHELL_STATIC_SUBCMD_SET_CREATE(network_conf_cmds,
			       SHELL_CMD(mode, &network_mode_accessor_cmds,
					 "Configure network mode", NULL),
			       SHELL_CMD(status, NULL, "Get network status",
					 handle_get_network_status),
			       SHELL_SUBCMD_SET_END);

SHELL_STATIC_SUBCMD_SET_CREATE(test_timeout_accessor_cmds,
			       SHELL_CMD(set, NULL, "Set initial timeout",
					 handle_set_timeout),
			       SHELL_CMD(get, NULL, "Get initial timeout",
					 handle_get_timeout),
			       SHELL_SUBCMD_SET_END);
SHELL_STATIC_SUBCMD_SET_CREATE(test_multiplier_accessor_cmds,
			       SHELL_CMD(set, NULL, "Set timeout multiplier",
					 handle_set_multiplier),
			       SHELL_CMD(get, NULL, "Get timeout multiplier",
					 handle_get_multiplier),
			       SHELL_SUBCMD_SET_END);
SHELL_STATIC_SUBCMD_SET_CREATE(test_conf_cmds,
			       SHELL_CMD(initial_timeout,
					 &test_timeout_accessor_cmds,
					 "Configure initial timeout", NULL),
			       SHELL_CMD(timeout_multiplier,
					 &test_multiplier_accessor_cmds,
					 "Configure timeout multiplier", NULL),
			       SHELL_SUBCMD_SET_END);
SHELL_STATIC_SUBCMD_SET_CREATE(test_conf_types_cmds,
			       SHELL_CMD(udp, &test_conf_cmds,
					 "Configure UDP test parameters", NULL),
			       SHELL_CMD(tcp, &test_conf_cmds,
					 "Configure TCP test parameters", NULL),
			       SHELL_SUBCMD_SET_END);
SHELL_STATIC_SUBCMD_SET_CREATE(conf_cmds,
			       SHELL_CMD(test, &test_conf_types_cmds,
					 "Read/Edit test parameters", NULL),
			       SHELL_CMD(network, &network_conf_cmds,
					 "Read/Edit network parameters", NULL),
			       SHELL_SUBCMD_SET_END);
SHELL_CMD_REGISTER(config, &conf_cmds, "Read/Edit NAT-test client parameters",
		   NULL);

SHELL_CMD_REGISTER(stop_running_test, NULL, "Stop running test",
		   handle_stop_test);

SHELL_STATIC_SUBCMD_SET_CREATE(
	test_types, SHELL_CMD(udp, NULL, "Start UDP test", handle_start_test),
	SHELL_CMD(tcp, NULL, "Start TCP test", handle_start_test),
	SHELL_CMD(udp_and_tcp, NULL, "Start first UDP test and then TCP test",
		  handle_start_test),
	SHELL_SUBCMD_SET_END);
SHELL_CMD_REGISTER(start, &test_types, "Start test", NULL);

static int json_add_obj(cJSON *parent, const char *str, cJSON *item)
{
	cJSON_AddItemToObject(parent, str, item);

	return 0;
}

static int json_add_str(cJSON *parent, const char *str, const char *item)
{
	cJSON *json_str;

	json_str = cJSON_CreateString(item);
	if (json_str == NULL) {
		return -ENOMEM;
	}

	return json_add_obj(parent, str, json_str);
}

static int create_send_buffer(struct modem_param_info *modem_params,
			      const struct at_cmd_log *item, char *buffer)
{
	int ret = 0;
	cJSON *root_obj = cJSON_CreateObject();

	if (root_obj == NULL) {
		printk("Failed to create json root object\n");
		return -ENOMEM;
	}

	ret += json_add_str(
		root_obj, "op",
		modem_params->network.current_operator.value_string);
	ret += json_add_str(root_obj, "iccid",
			    modem_params->sim.iccid.value_string);
	ret += json_add_str(root_obj, "imei",
			    modem_params->device.imei.value_string);
	ret += json_add_str(root_obj, "cmd", item->cmd);
	ret += json_add_str(root_obj, "result", item->res);

	if (ret) {
		printk("Failed to add json value\n");
		ret = -ENOMEM;
		goto exit;
	}

	char *root_obj_string = cJSON_Print(root_obj);

	if (root_obj_string == NULL) {
		printk("Failed to print json object\n");
		ret = -1;
		goto exit;
	}

	ret = strlen(root_obj_string);
	memcpy(buffer, root_obj_string, ret);
	cJSON_FreeString(root_obj_string);

exit:
	cJSON_Delete(root_obj);

	return ret;
}

static int send_data(int client_fd, struct at_cmd_log *item)
{
	int err;
	char send_buf[BUF_SIZE] = { 0 };
	int send_len;
	struct modem_param_info modem_params = { 0 };

	err = modem_info_params_init(&modem_params);
	if (err) {
		printk("Modem info params could not be initialised: %d\n", err);
		return -1;
	}

	err = modem_info_params_get(&modem_params);
	if (err < 0) {
		printk("Unable to obtain modem parameters: %d\n", err);
		return -ENOTCONN;
	}

	send_len = create_send_buffer(&modem_params, item, send_buf);
	if (send_len < 0) {
		return -1;
	}

	/* send len + 1 for null terminated packet */
	err = send(client_fd, send_buf, send_len + 1, 0);
	if (err < 0) {
		printk("Failed to send data, errno: %d\n", errno);

		return -ENOTCONN;
	}

	printk("AT cmd and result sent: %s\n", send_buf);
	return 0;
}

static int setup_connection(int *client_fd, struct pollfd *fds)
{
	int err;
	struct addrinfo *res;
	struct addrinfo hints = {
		.ai_family = AF_INET,
		.ai_socktype = SOCK_STREAM,
	};

	int network_status = get_network_status();

	if ((network_status != LTE_LC_NW_REG_REGISTERED_HOME) &&
	    (network_status != LTE_LC_NW_REG_REGISTERED_ROAMING)) {
		return -1;
	}

	*client_fd = socket(AF_INET, SOCK_STREAM, IPPROTO_TCP);
	if (client_fd <= 0) {
		printk("socket() failed, errno: %d\n", errno);
		return -1;
	}

	k_sem_take(&getaddrinfo_sem, K_FOREVER);
	err = getaddrinfo(SERVER_HOSTNAME, NULL, &hints, &res);
	if (err) {
		printk("getaddrinfo() failed, err %d\n", errno);
		k_sem_give(&getaddrinfo_sem);
		return -1;
	}
	k_sem_give(&getaddrinfo_sem);

	((struct sockaddr_in *)res->ai_addr)->sin_port =
		htons(AT_CMD_SERVER_PORT);

	err = connect(*client_fd, res->ai_addr, sizeof(struct sockaddr_in));
	if (err) {
		printk("connect failed, errno: %d\n\r", errno);
		return -1;
	}

	fds->fd = *client_fd;
	fds->events = POLLIN;

	return 0;
}

static void thread_entry_point(void *param, void *unused, void *unused2)
{
	struct k_fifo *fifo = (struct k_fifo *)param;
	struct pollfd fds = { 0 };
	char recv_buf[BUF_SIZE];
	int client_fd = 0;
	int err;
	int ret_len;
	bool connected;

	err = setup_connection(&client_fd, &fds);
	if (err < 0) {
		connected = false;
	} else {
		connected = true;
	}
	while (true) {
		while (!k_fifo_is_empty(fifo)) {
			if (!connected) {
				goto reconnect;
			}

			struct at_cmd_log *item =
				(struct at_cmd_log *)k_fifo_get(fifo,
								K_NO_WAIT);

			/* Should not ever be NULL */
			if (item != NULL) {
				printk("Item: %s, %s\n", item->cmd, item->res);
				err = send_data(client_fd, item);
				if (err == ENOTCONN) {
					k_fifo_put(fifo, (void *)item);
					goto reconnect;
				} else if (err < 0) {
					free(item);
					printk("Exiting AT command client thread.\n");
					return;
				}

				free(item);

				memset(recv_buf, 0, BUF_SIZE);

				err = poll(&fds, 1,
					   AT_LOG_TIMEOUT_S * S_TO_MS_MULT);
				if (err < 0) {
					printk("poll, error: %d", err);
					goto reconnect;
				} else if (err == 0) {
					printk("No response from server.\nAppending AT log back into fifo.\n");
					k_fifo_put(fifo, (void *)item);
					goto reconnect;
				} else if ((fds.revents & POLLIN) == POLLIN) {
					ret_len = recv(client_fd, recv_buf,
						       sizeof(recv_buf) - 1, 0);
					if (ret_len > 0 && ret_len < BUF_SIZE) {
						recv_buf[ret_len] = 0;

						if (strstr(recv_buf, "error") !=
							    NULL ||
						    strstr(recv_buf, "Error") !=
							    NULL) {
							printk("Response: %s\nExiting AT command client thread.\n",
							       recv_buf);
							return;
						}

						printk("Response: %s\n",
						       recv_buf);
					}
				}
			}
		}

		k_sleep(K_SECONDS(WAIT_TIME_S));

		continue;

	reconnect:
		(void)close(client_fd);

		connected = false;

		err = setup_connection(&client_fd, &fds);
		if (err < 0) {
			printk("Failed to connect to server.\nEmptying fifo.\n");
			/* Empty queue */
			while (!k_fifo_is_empty(fifo)) {
				k_fifo_get(fifo, K_NO_WAIT);
			}
			continue;
		}

		connected = true;
	}
}

void nat_cmd_init(void)
{
	k_thread_create(&thread, nat_cmd_thread_stack_area, THREAD_STACK_SIZE,
			thread_entry_point, (void *)&at_cmd_fifo, NULL, NULL,
			THREAD_PRIORITY, 0, K_NO_WAIT);
}
```

## src/nat_test.c
```c
/*
 * Copyright (c) 2020 Nordic Semiconductor ASA
 *
 * SPDX-License-Identifier: LicenseRef-BSD-5-Clause-Nordic
 */

#include <zephyr.h>
#include <cJSON.h>
#include <cJSON_os.h>
#include <modem/lte_lc.h>
#include <modem/modem_info.h>
#include <net/socket.h>
#include <stdarg.h>
#include <stdio.h>

#include "nat_test.h"

#define UDP_PORT 3050
#define TCP_PORT 3051
#define WAIT_LOG_THRESHOLD_MS (60 * S_TO_MS_MULT)
#define TIMEOUT_TOL_S 10
#define DEFAULT_UDP_INITIAL_TIMEOUT 1
#define DEFAULT_TCP_INITIAL_TIMEOUT 300
#define DEFAULT_UDP_TIMEOUT_MULTIPLIER 2
#define DEFAULT_TCP_TIMEOUT_MULTIPLIER 1.5
#define IP_STRINGS_COUNT 10

struct test_thread_timeout {
	int timeout;
	double multiplier;
	int lower;
	int upper;
};

struct test_thread_data {
	atomic_t type;
	atomic_t state;
	struct k_sem sem;
	struct test_thread_timeout timeout_data;
};

struct test_thread {
	struct k_thread thread;
	k_tid_t tid;
	k_thread_stack_t *stack_area;
	struct test_thread_data thread_data;
};

K_THREAD_STACK_DEFINE(nat_test_thread_stack_area, THREAD_STACK_SIZE);

static struct test_thread test_thread;

volatile int udp_initial_timeout;
volatile int tcp_initial_timeout;
volatile float udp_timeout_multiplier;
volatile float tcp_timeout_multiplier;

int get_test_state(void)
{
	return atomic_get(&test_thread.thread_data.state);
}

static int json_add_obj(cJSON *parent, const char *str, cJSON *item)
{
	cJSON_AddItemToObject(parent, str, item);

	return 0;
}

static int json_add_str(cJSON *parent, const char *str, const char *item)
{
	cJSON *json_str;

	json_str = cJSON_CreateString(item);
	if (json_str == NULL) {
		return -ENOMEM;
	}

	return json_add_obj(parent, str, json_str);
}

static int json_add_number(cJSON *parent, const char *str, double item)
{
	cJSON *json_num;

	json_num = cJSON_CreateNumber(item);
	if (json_num == NULL) {
		return -ENOMEM;
	}

	return json_add_obj(parent, str, json_num);
}

static int create_send_buffer(struct modem_param_info *const modem_params,
			      char *buffer, int timeout_s)
{
	int ret = 0;
	cJSON *root_obj = cJSON_CreateObject();
	cJSON *ip_obj;
	const char *delim = " ";
	const char *ip_strings[IP_STRINGS_COUNT];
	int ip_count = 0;

	if (root_obj == NULL) {
		printk("Failed to create json root object\n");
		return -ENOMEM;
	}

	char *token =
		strtok(modem_params->network.ip_address.value_string, delim);
	while (token != NULL) {
		if (ip_count >= ARRAY_SIZE(ip_strings)) {
			printk("More than %d addresses found. Remainder will not be added to json\n",
			       IP_STRINGS_COUNT);
			break;
		}
		ip_strings[ip_count] = token;
		token = strtok(NULL, delim);
		ip_count++;
	}

	ip_obj = cJSON_CreateStringArray(ip_strings, ip_count);
	if (ip_obj == NULL) {
		printk("Failed to create json ip object\n");
		ret = -ENOMEM;
		goto exit;
	}

	ret += json_add_obj(root_obj, "ip", ip_obj);
	ret += json_add_str(
		root_obj, "op",
		modem_params->network.current_operator.value_string);
	ret += json_add_number(root_obj, "cell_id",
			       modem_params->network.cellid_dec);
	ret += json_add_number(root_obj, "ue_mode",
			       modem_params->network.ue_mode.value);
	ret += json_add_number(root_obj, "lte_mode",
			       modem_params->network.lte_mode.value);
	ret += json_add_number(root_obj, "nbiot_mode",
			       modem_params->network.nbiot_mode.value);
	ret += json_add_str(root_obj, "iccid",
			    modem_params->sim.iccid.value_string);
	ret += json_add_str(root_obj, "imei",
			    modem_params->device.imei.value_string);
	ret += json_add_number(root_obj, "interval", timeout_s);

	if (ret) {
		printk("Failed to add json value\n");
		ret = -ENOMEM;
		goto exit;
	}

	char *root_obj_string = cJSON_Print(root_obj);

	if (root_obj_string == NULL) {
		printk("Failed to print json object\n");
		ret = -1;
		goto exit;
	}

	ret = strlen(root_obj_string);
	memcpy(buffer, root_obj_string, ret);
	cJSON_FreeString(root_obj_string);

exit:
	cJSON_Delete(root_obj);

	return ret;
}

static int send_data(int client_fd, int timeout_s,
		     struct modem_param_info *const modem_params)
{
	int err;
	char send_buf[BUF_SIZE] = { 0 };
	int send_len;

	send_len = create_send_buffer(modem_params, send_buf, timeout_s);
	if (send_len < 0) {
		return -1;
	}

	/* send len + 1 for null terminated packet */
	err = send(client_fd, send_buf, send_len + 1, 0);
	if (err < 0) {
		printk("Failed to send data, errno: %d\n", errno);

		return -ENOTCONN;
	}

	printk("Packet sent: %s\n", send_buf);
	return 0;
}

static int poll_and_read(int client_fd, int timeout_s, atomic_t *state)
{
	int err;
	char recv_buf[BUF_SIZE] = { 0 };
	size_t ret_len;
	struct pollfd fds[] = { { .fd = client_fd, .events = POLLIN } };
	s64_t start_time_ms = k_uptime_get();
	s64_t per_log_poll_time_ms = 0;
	s64_t total_poll_time_ms = 0;

	while (1) {
		if (atomic_get(state) == ABORT) {
			return -1;
		}

		err = poll(fds, ARRAY_SIZE(fds), WAIT_TIME_S * S_TO_MS_MULT);
		if (err < 0) {
			printk("poll, error: %d", err);

			return -ENOTCONN;
		} else if (err == 0) {
			int delta = k_uptime_delta(&start_time_ms);

			per_log_poll_time_ms += delta;
			total_poll_time_ms += delta;
			if (total_poll_time_ms <=
			    (timeout_s + TIMEOUT_TOL_S) * S_TO_MS_MULT) {
				if (per_log_poll_time_ms >=
				    WAIT_LOG_THRESHOLD_MS) {
					printk("Elapsed time: %d of %d seconds (%d seconds tolerance)\n",
					       (int)(total_poll_time_ms /
						     S_TO_MS_MULT),
					       timeout_s + TIMEOUT_TOL_S,
					       TIMEOUT_TOL_S);
					per_log_poll_time_ms = 0;
				}

				continue;
			}

			printk("No response from server\n");
			return 0;
		} else if ((fds[0].revents & POLLIN) == POLLIN) {
			ret_len = recv(client_fd, recv_buf,
				       sizeof(recv_buf) - 1, 0);
			if (ret_len > 0 && ret_len < BUF_SIZE) {
				recv_buf[ret_len] = 0;

				if (strstr(recv_buf, "error") != NULL ||
				    strstr(recv_buf, "Error") != NULL) {
					printk("Response: %s\n", recv_buf);
					return -1;
				}

				printk("Response: %s\n", recv_buf);
				return 1;
			}
		}
	}
}

static int setup_connection(int *client_fd, enum test_type type, int port,
			    atomic_t *state)
{
	int err;
	struct addrinfo *res;
	struct addrinfo hints = {
		.ai_family = AF_INET,
	};

	if (type == TEST_UDP) {
		*client_fd = socket(AF_INET, SOCK_DGRAM, IPPROTO_UDP);
		if (client_fd <= 0) {
			printk("socket() failed, errno: %d\n", errno);
			return -1;
		}

		hints.ai_socktype = SOCK_DGRAM;
	} else if (type == TEST_TCP) {
		*client_fd = socket(AF_INET, SOCK_STREAM, IPPROTO_TCP);
		if (client_fd <= 0) {
			printk("socket() failed, errno: %d\n", errno);
			return -2;
		}

		hints.ai_socktype = SOCK_STREAM;
	} else {
		return -1;
	}

	k_sem_take(&getaddrinfo_sem, K_FOREVER);
	err = getaddrinfo(SERVER_HOSTNAME, NULL, &hints, &res);
	if (err) {
		k_sem_give(&getaddrinfo_sem);
		printk("getaddrinfo() failed, err %d\n", errno);
		return -1;
	}
	k_sem_give(&getaddrinfo_sem);

	((struct sockaddr_in *)res->ai_addr)->sin_port = htons(port);

	err = connect(*client_fd, res->ai_addr, sizeof(struct sockaddr_in));
	if (err) {
		printk("connect failed, errno: %d\n\r", errno);
		return -1;
	}

	printk("Connected to server\n");

	return 0;
}

static bool get_timeout_binary_search(struct test_thread_timeout *timeout_data,
				      bool timed_out)
{
	if (timed_out) {
		timeout_data->upper = timeout_data->timeout;
	} else {
		timeout_data->lower = timeout_data->timeout;
	}

	if ((timeout_data->upper - timeout_data->lower) == 1) {
		timeout_data->timeout = timeout_data->lower;

		return true;
	}

	timeout_data->timeout =
		timeout_data->lower +
		((timeout_data->upper - timeout_data->lower) / 2);
	return false;
}

static void init_values(struct test_thread_timeout *timeout_data,
			enum test_type type, int *port)
{
	timeout_data->lower = 0;
	timeout_data->upper = 0;

	switch (type) {
	case TEST_UDP:
		timeout_data->timeout = udp_initial_timeout;
		timeout_data->multiplier = udp_timeout_multiplier;
		*port = UDP_PORT;
		break;
	case TEST_TCP:
		timeout_data->timeout = tcp_initial_timeout;
		timeout_data->multiplier = tcp_timeout_multiplier;
		*port = TCP_PORT;
		break;
	default:
		/* Unused */
		break;
	}
}

static void nat_test_run_single(enum test_type type,
				struct test_thread_timeout *timeout_data,
				atomic_t *state)
{
	int err;
	int client_fd;
	bool finished = false;
	bool using_binary_search = false;
	int port = 0;
	enum lte_lc_nw_reg_status network_status = get_network_status();
	struct modem_param_info modem_params = { 0 };

	if ((network_status != LTE_LC_NW_REG_REGISTERED_HOME) &&
	    (network_status != LTE_LC_NW_REG_REGISTERED_ROAMING)) {
		printk("LTE link not established.\nAborting test.\n");
		return;
	}

	init_values(timeout_data, type, &port);

	err = setup_connection(&client_fd, type, port, state);
	if (err < 0) {
		return;
	}

	err = modem_info_params_init(&modem_params);
	if (err) {
		printk("Modem info params could not be initialised: %d\n", err);
		return;
	}

	err = modem_info_params_get(&modem_params);
	if (err < 0) {
		printk("Unable to obtain modem parameters: %d\n", err);
		return;
	}

	while (!finished) {
		if (atomic_get(state) == ABORT) {
			goto abort;
		}

		err = send_data(client_fd, timeout_data->timeout,
				&modem_params);
		if (err < 0) {
			if (err == -ENOTCONN) {
				goto reconnect;
			}
			goto abort;
		}

		err = poll_and_read(client_fd, timeout_data->timeout, state);
		if (err < 0) {
			if (err == -ENOTCONN) {
				goto reconnect;
			}
			goto abort;
		} else if (err == 0) {
			using_binary_search = true;
			finished =
				get_timeout_binary_search(timeout_data, true);
			goto reconnect;
		} else if (err > 0 && using_binary_search) {
			finished =
				get_timeout_binary_search(timeout_data, false);
		}

		if (!using_binary_search) {
			timeout_data->lower = timeout_data->timeout;
			timeout_data->timeout *= timeout_data->multiplier;
		}

		continue;

	reconnect:
		network_status = get_network_status();

		/* Wait for LTE link to be established or for test to be aborted */
		while (true) {
			if (atomic_get(state) == ABORT) {
				goto abort;
			} else if ((network_status ==
				    LTE_LC_NW_REG_REGISTERED_HOME) ||
				   (network_status ==
				    LTE_LC_NW_REG_REGISTERED_ROAMING)) {
				break;
			}
			k_sleep(K_SECONDS(WAIT_TIME_S));
			network_status = get_network_status();
		}

		close(client_fd);

		err = setup_connection(&client_fd, type, port, state);
		if (err < 0) {
			return;
		}
	}

	printk("Finished NAT timeout measurements\nMax keep-alive time: %d seconds\n",
	       timeout_data->timeout);

abort:
	(void)close(client_fd);
}

static void nat_test_run_both(struct test_thread_data *thread_data)
{
	nat_test_run_single(TEST_UDP, &thread_data->timeout_data,
			    &thread_data->state);

	if (atomic_get(&thread_data->state) != ABORT) {
		nat_test_run_single(TEST_TCP, &thread_data->timeout_data,
				    &thread_data->state);
	}
}

int nat_test_start(enum test_type type)
{
	switch (atomic_get(&test_thread.thread_data.state)) {
	case RUNNING:
	case ABORT:
		return -1;
	case IDLE:
	default:
		break;
	}

	atomic_set(&test_thread.thread_data.type, type);
	k_sem_give(&test_thread.thread_data.sem);

	return 0;
}

int nat_test_stop(void)
{
	switch (atomic_get(&test_thread.thread_data.state)) {
	case RUNNING:
		atomic_set(&test_thread.thread_data.state, ABORT);
	case ABORT:
		/* Give test thread enough time to detect abort request */
		for (int i = 0; i < WAIT_TIME_S * 2; i++) {
			if (atomic_get(&test_thread.thread_data.state) ==
			    IDLE) {
				return 0;
			}
			k_sleep(K_SECONDS(1));
		}
		return -1;
	case IDLE:
	default:
		break;
	}

	return 0;
}

static void nat_test_thread_entry_point(void *param, void *unused,
					void *unused2)
{
	struct test_thread_data *thread_data = (struct test_thread_data *)param;

	atomic_set(&thread_data->state, IDLE);

	while (true) {
		k_sem_take(&thread_data->sem, K_FOREVER);

		atomic_set(&thread_data->state, RUNNING);

		printk("Test started\n");
		switch (atomic_get(&thread_data->type)) {
		case TEST_UDP:
		case TEST_TCP:
			nat_test_run_single(thread_data->type,
					    &thread_data->timeout_data,
					    &thread_data->state);
			break;
		case TEST_UDP_AND_TCP:
			nat_test_run_both(thread_data);
			break;
		default:
			printk("Thread with invalid type started");
			return;
		}
		atomic_set(&thread_data->state, IDLE);
		printk("Test idle\n");
	}
}

static void prepare_and_start_thread(struct test_thread *thread)
{
	k_sem_init(&thread->thread_data.sem, 0, 1);
	thread->stack_area = nat_test_thread_stack_area;
	atomic_set(&thread->thread_data.state, UNINITIALIZED);

	thread->tid =
		k_thread_create(&thread->thread, thread->stack_area,
				THREAD_STACK_SIZE, nat_test_thread_entry_point,
				(void *)&thread->thread_data, NULL, NULL,
				THREAD_PRIORITY, 0, K_NO_WAIT);
}

void nat_test_init(void)
{
	udp_initial_timeout = DEFAULT_UDP_INITIAL_TIMEOUT;
	tcp_initial_timeout = DEFAULT_TCP_INITIAL_TIMEOUT;
	udp_timeout_multiplier = DEFAULT_UDP_TIMEOUT_MULTIPLIER;
	tcp_timeout_multiplier = DEFAULT_TCP_TIMEOUT_MULTIPLIER;

	prepare_and_start_thread(&test_thread);
}
```

## src/nat_test.h
```c
/*
 * Copyright (c) 2020 Nordic Semiconductor ASA
 *
 * SPDX-License-Identifier: LicenseRef-BSD-5-Clause-Nordic
 */

#ifndef NAT_TEST_H_
#define NAT_TEST_H_

#define SERVER_HOSTNAME "nat-test.thingy.rocks"
#define BUF_SIZE 512
#define THREAD_PRIORITY 5
#define THREAD_STACK_SIZE 8192
#define WAIT_TIME_S 3
#define S_TO_MS_MULT 1000

enum test_type { TEST_UDP = 0, TEST_TCP = 1, TEST_UDP_AND_TCP = 2 };

enum test_state { UNINITIALIZED, IDLE, RUNNING, ABORT };

enum set_network_mode_error { SUCCESS = 0, INVALID_MODE = 1, TEST_RUNNING = 2 };

extern volatile int udp_initial_timeout;
extern volatile int tcp_initial_timeout;
extern volatile float udp_timeout_multiplier;
extern volatile float tcp_timeout_multiplier;

extern struct k_sem getaddrinfo_sem;

/**
 * @brief Function to get current test state
 */
int get_test_state(void);

/**
 * @brief Function to get network mode
 */
int get_network_mode(void);

/**
 * @brief Function to set network mode
 *
 * @param mode New network mode. LTE_LC_SYSTEM_MODE_LTEM = 1 or LTE_LC_SYSTEM_MODE_NB_IOT = 2
 */
int set_network_mode(int mode);

/**
 * @brief Function to get network status
 */
int get_network_status(void);

/**
 * @brief Function to stop running test
 */
int nat_test_stop(void);

/**
 * @brief Function to start test
 *
 * @param type Test type
 */
int nat_test_start(enum test_type type);

/**
 * @brief Function for initializing the NAT-test client.
 */
void nat_test_init(void);

/**
 * @brief Function for initializing the NAT-cmd module.
 */
void nat_cmd_init(void);

#endif /* NAT_TEST_H_ */
```
